## main/Kconfig.projbuild
```kconfig
# put here your custom config value
# menu "Strela-Vlna WiFi config"
# config SV_WIFI0_SSID
#     string "SSID 0"
#     default "ssid0"
#
# config SV_WIFI0_PASSWORD
#     string "PASSKEY 0"
#     default "mypassword"
# endmenu



menu "Strela-Vlna general config"
config SV_SOFTWARE_VERSION
    string "Software version"
    default "2.0 beta"
    help
    The version of the software inside the device.
config SV_DEVICE_ID
    string "Device ID"
    default 0
    help
    The ID of device (currently used are 1 and 2).
config SV_SERVER
    string "Strela-Vlna server URL"
    default "http://192.168.67.69:80"
    help
    Server that the device will connect to.
config SV_SECRET_KEY
    string "Server secret key"
    default "<super-secret-key>"
    help
    Key that the device will use to authenticate itself with the server (temporary before some real encryption can be implemented).

config SV_WIFI_SSID
    string "WiFi SSID"
    default "<ssid0>:<ssid1>:<ssid2>"

config SV_WIFI_PASSWORD
    string "WiFi password"
    default "<pass0>:<pass1>:<pass2>"
endmenu
```
